const int m_len= 127;                                         //длина м-последовательности

int m_array[m_len] =                                          //эталонная м-последовательность
{
  0,0,0,0,0,0,1,0,0,0,0,0,1,1,0,0,0,0,1,0,
  1,0,0,0,1,1,1,1,0,0,1,0,0,0,1,0,1,1,0,0,
  1,1,1,0,1,0,1,0,0,1,1,1,1,1,0,1,0,0,0,0,
  1,1,1,0,0,0,1,0,0,1,0,0,1,1,0,1,1,0,1,0,
  1,0,1,1,1,1,0,1,1,0,0,0,1,1,0,1,0,0,1,0,
  1,1,1,0,1,1,1,0,0,1,1,0,0,1,0,1,0,1,0,1,
  1,1,1,1,1,1,0};

int input_array[m_len];                                        //входящая м-последовательность
  
void setup() {                                                 //параметры инициализациии
  Serial.begin(9600);                                          //скорость обмена
  pinMode(2, INPUT);                                           //вход данных с приемника
  pinMode(4, OUTPUT);                                          //вывод питания приемника
  digitalWrite(4, HIGH);                                       //на вывод питания приемника 5 вольт
  pinMode(7, OUTPUT);                                          //земля передатчика
  digitalWrite(7, LOW);                                        //низкий уровень на землю передатчика
  pinMode(8, OUTPUT);                                          //вывод питания передатчика
  digitalWrite(8, HIGH);                                       //на вывод питания передатчика 5 вольт
  pinMode(9, OUTPUT);                                          //выход данных на передатчик
  digitalWrite(9, HIGH);                                       //начальное значение на выводе данных
}

void my_print() {                                              //функция вывода сообщения в монитор порта
  for (int j=0; j<m_len; j++)
  { 
    Serial.print(String(input_array[j]));                      //выводим входящую м-последовательност
  }
  Serial.print("\n");                                          //выводи символ переноса
}

void loop() {                                                  //основной цикл
  for (int j=0; j<m_len; j++)                                  //обойти в цикле м-последовательность
  { 
    if (m_array[j] == 1){                                      //если элемент передаваемого массива равен 1
      digitalWrite(9, HIGH);                                   //отправляем в передатчик "1"
    }
    if (m_array[j] == 0){                                      //если элемент передаваемого массива равен 0
      digitalWrite(9, LOW);                                    //отправляем в передатчик "0"
    }
    delay(1);                                                  //пауза 1 мс
    if (digitalRead(2) == HIGH){                               //если на входе высокий уровень
      input_array[j] = 1;                                      //записываем в массив 1
    }
    if (digitalRead(2) == LOW){                                //если на входе низкий уровень
      input_array[j] = 0;                                      //записываем в массив 0
    }
    delay(1);                                                  //пауза 1 мс
  }
  my_print();                                                  //вызываем функцию вывода сообщения
  delay(10);                                                   //пауза 10 мс
}
